## config/boards/shields/input/Kconfig.defconfig
```kconfig
# Copyright (c) 2020 The ZMK Contributors
# SPDX-License-Identifier: MIT

config ZMK_BLE
	default y

config ZMK_USB
	default y

if SHIELD_INPUT_LEFT

config ZMK_KEYBOARD_NAME
    default "Input"

config ZMK_SPLIT_BLE_ROLE_CENTRAL
    default y

endif

if SHIELD_INPUT_LEFT || SHIELD_INPUT_RIGHT

config ZMK_SPLIT
    default y

endif
```
